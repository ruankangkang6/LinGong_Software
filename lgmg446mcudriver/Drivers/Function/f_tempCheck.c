/*
 * f_tempCheck..c
 *
 *  Created on: 2024年12月17日
 *      Author: pc
 */
#include "f_public.h"

float g_DerateTorq = 0;            //温度限制扭矩
TEMPLETURE_STRUCT gTemperature = {0, 0, 0, 0, 0, 0, 0, 0, 0, 0, 0, 0, 0, 0};

static float TemperatureSearch( const int16_t *TableAddr, int16_t iTempModuleAD, int16_t i16Min, int16_t i16Max );//温度查表函数
static float TemperatureSearch1( const int16_t *TableAddr, int16_t iTempModuleAD, int16_t i16Min, int16_t i16Max );//温度查表函数1



#define MIN_IGBT_TEMP       0           //-40
#define MAX_IGBT_TEMP       165         //125
static const int16_t tableIGBTTemp[MAX_IGBT_TEMP + 1] =
{
	4033 ,		 4029 ,		 4024 ,		 4019 ,		 4015 ,		 4010 ,		 4004 ,		 3997 ,		 3991 ,		 3985 ,
	3979 ,		 3971 ,		 3963 ,		 3955 ,		 3947 ,		 3939 ,		 3929 ,		 3918 ,		 3908 ,		 3898 ,
	3888 ,		 3875 ,		 3862 ,		 3850 ,		 3837 ,		 3824 ,		 3809 ,		 3793 ,		 3777 ,		 3762 ,
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	302 ,		 295 ,		 289 ,		 282 ,		 275 ,		 269

};



#define MIN_MOTOR_TEMP      62          //-50
#define MAX_MOTOR_TEMP      979         //170
#if MOTOR_TEMP_SENSOR == PT1000
static const int16_t Pt1000RtTab[]={	//10bit adc
		-50,	-50,	-50,	-50,	-50,	-49,	-49,	-49,	-49,	-49,	-48,	-48,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	-41,
		-40,	-40,	-40,	-40,	-40,	-39,	-39,	-39,	-39,	-39,	-38,	-38,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	-31,
		-30,	-30,	-30,	-30,	-30,	-29,	-29,	-29,	-29,	-29,	-28,	-28,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	-21,
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		180,
};
#if 0
static const int16_t tableMotorTemp[MAX_MOTOR_TEMP + 1] =
{
    1660,
    1668,   1675,   1683,   1691,   1699,   1707,   1715,   1723,   1730,   1738,
    1746,   1754,   1762,   1770,   1777,   1785,   1793,   1801,   1809,   1816,
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    3415,   3421,   3428,   3435,   3441,   3448,   3455,   3461,   3468,   3475
};
#endif
#endif


#define MIN_AMB_TEMP        0           //-40
#define MAX_AMB_TEMP        160         //-100
static const int16_t tableAMBTemp[MAX_AMB_TEMP + 1] =
{
	4050,        4047,        4044,        4041,        4037,        4033,        4029,        4025,
	4020,        4015,        4010,        4005,        4000,        3994,        3988,        3981,
	3974,        3967,        3960,        3952,        3944,        3936,        3927,        3918,
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	678 ,        664,         651,         638,         625,         613,         601,         589,
	577

};

/*-40 - 60*/
#define MOTOR_TEMP_LO_MIN	0	//-40
#define MOTOR_TEMP_LO_MAX   100  //60
const int16_t MotorTempLoTable[]={
3723,	3704,	3684,	3663,	3641,	3618,	3595,	3571,	3546,	3520,	3493,	3466,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	537,
};
/*50 - 170*/
#define MOTOR_TEMP_HI_MIN	0	//50
#define MOTOR_TEMP_HI_MAX   120 //170
const int16_t MotorTempHiTable[]={
2865,	2837,	2809,	2780,	2751,	2722,	2693,	2664,	2635,	2605,	2576,	2546,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	398,
};
/*-40 - 125*/
#define NTC10K_TEMP_MIN		0	//-40
#define NTC10K_TEMP_MAX   165   //125
const int16_t Ntc10kTempTable[]={
4029,	4025,	4020,	4016,	4011,	4006,	4000,	3995,	3989,	3982,	3976,	3969,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	256,
};
void TemperatureCheck(void)
{
	static uint8 temp_hi_lo;

    //根据采样值查温度值
/*IGBT temperature*/
    //gTemperature.Temp       = TemperatureSearch1( tableIGBTTemp,  gTemperature.TempAD, MIN_IGBT_TEMP,  MAX_IGBT_TEMP ) - 40;
    gTemperature.Temp       = TemperatureSearch1( Ntc10kTempTable,  gTemperature.TempAD, NTC10K_TEMP_MIN,  NTC10K_TEMP_MAX ) - 40;
/*motor temperature*/

    if(temp_hi_lo==0)
    {
    	gTemperature.MotorTemp       = TemperatureSearch1( MotorTempLoTable,  gTemperature.MotorTempAD, MOTOR_TEMP_LO_MIN,  MOTOR_TEMP_LO_MAX ) - 40;
    }
    else
    {
    	gTemperature.MotorTemp       = TemperatureSearch1( MotorTempHiTable,  gTemperature.MotorTempAD, MOTOR_TEMP_HI_MIN,  MOTOR_TEMP_HI_MAX ) + 50;
    }
    gTemperature.MotorTemp2 = gTemperature.MotorTemp;
    if(gTemperature.MotorTemp>=60.0)
	{
    	temp_hi_lo = 1;
    	HAL_GPIO_WritePin(GPIOC, GPIO_PIN_3, GPIO_PIN_SET);
	}
	else if(gTemperature.MotorTemp<=50.0)
	{
		temp_hi_lo = 0;
		HAL_GPIO_WritePin(GPIOC, GPIO_PIN_3, GPIO_PIN_RESET);
	}


/*ambient temperature*/
	//gTemperature.AMBTemp    = TemperatureSearch1( tableAMBTemp,  gTemperature.TempAMBAD2, MIN_AMB_TEMP,  MAX_AMB_TEMP ) -40;
	gTemperature.AMBTemp       = TemperatureSearch1( Ntc10kTempTable,  gTemperature.TempAMBAD2, NTC10K_TEMP_MIN,  NTC10K_TEMP_MAX ) - 40;

    TemperatureProtect();   //温度保护
}

/************************************************************
             温度查表函数
************************************************************/
static float TemperatureSearch1( const int16_t *TableAddr, int16_t iTempModuleAD, int16_t i16Min, int16_t i16Max )
{
	int16_t i16Low    =   i16Min;
    int16_t i16Mid    =   0;
    int16_t i16High   =   i16Max;
    int16_t i16Diff   =   0;
    int16_t i16Find   =   0;

    float f32Value = 0;

    if ( iTempModuleAD <= *( TableAddr + i16High -1 ) )
    {
        f32Value = i16Max;
    }
    else if ( iTempModuleAD >= *TableAddr )
    {
        f32Value = i16Min;
    }
    else
    {
        while( i16Low < i16High - 1  && 0 == i16Find )
        {
            i16Mid  = (( i16Low + i16High )>>1);
            i16Diff = iTempModuleAD - *( TableAddr + i16Mid );

            if( 0 == i16Diff )
            {
                i16Find = 1;
            }
            else if( i16Diff < 0 )
            {
                i16Low = i16Mid;
                i16Mid = i16High;

            }
            else
            {
                i16High = i16Mid;
                i16Mid  = i16High;

            }
        }

        if( i16Min == i16Mid )
        {
            i16Low  =   i16Min;
            i16High =   i16Min + 1;
        }
        else if( i16Max - 1 == i16Mid )
        {
            i16Low  =   i16Max - 2;
            i16High =   i16Max - 1;
        }
        else
        {
            if( iTempModuleAD > TableAddr[i16Mid] )
            {
                i16Low  =   i16Mid;
                i16High =   i16Mid + 1;
            }
            else
            {
                i16Low  =   i16Mid - 1;
                i16High =   i16Mid;
            }
        }

        f32Value = ( (float)(iTempModuleAD) - TableAddr[i16Low] )/( TableAddr[i16High] - TableAddr[i16Low] );
        f32Value += i16Low;

    }

    return f32Value;
}


static float TemperatureSearch( const int16_t *TableAddr, int16_t iTempModuleAD, int16_t i16Min, int16_t i16Max )
{
	int16_t i16Low    =   i16Min;
    int16_t i16Mid    =   0;
    int16_t i16High   =   i16Max;
    int16_t i16Diff   =   0;
    int16_t i16Find   =   0;

    float f32Value = 0;

    if ( iTempModuleAD >= *( TableAddr + i16High -1 ) )
    {
        f32Value = i16Max;
    }
    else if ( iTempModuleAD <= *TableAddr )
    {
        f32Value = i16Min;
    }
    else
    {
        while( i16Low < i16High - 1  && 0 == i16Find )
        {
            i16Mid  = (( i16Low + i16High )>>1);
            i16Diff = iTempModuleAD - *( TableAddr + i16Mid );

            if( 0 == i16Diff )
            {
                i16Find = 1;
            }
            else if( i16Diff < 0 )
            {
                i16High = i16Mid;
                i16Mid  = i16High;
            }
            else
            {
                i16Low = i16Mid;
                i16Mid = i16High;
            }
        }

        if( i16Min == i16Mid )
        {
            i16Low  =   i16Min;
            i16High =   i16Min + 1;
        }
        else if( i16Max - 1 == i16Mid )
        {
            i16Low  =   i16Max - 2;
            i16High =   i16Max - 1;
        }
        else
        {
            if( iTempModuleAD > TableAddr[i16Mid] )
            {
                i16Low  =   i16Mid;
                i16High =   i16Mid + 1;
            }
            else
            {
                i16Low  =   i16Mid - 1;
                i16High =   i16Mid;
            }
        }

        f32Value = ( (float)(iTempModuleAD) - TableAddr[i16Low] )/( TableAddr[i16High] - TableAddr[i16Low] );
        f32Value += i16Low;

    }

    return f32Value;
}

